## boards/holtek/esk32_30502/Kconfig.defconfig
```kconfig
# Copyright (c) 2025 Alex Fabre <alex.fabre@rtone.fr>
# SPDX-License-Identifier: Apache-2.0

if BOARD_ESK32_30502

config BOARD
	default "esk32_30502"

endif # BOARD_ESK32_30502
```

## boards/holtek/esk32_30502/Kconfig.esk32_30502
```kconfig
# Copyright (c) 2025 Alex Fabre <alex.fabre@rtone.fr>
# SPDX-License-Identifier: Apache-2.0

config BOARD_ESK32_30502
	select SOC_HT32F52341
```

## boards/holtek/esk32_30502/board.yml
```yaml
board:
  name: esk32_30502
  full_name: ESK32-30502 Starter Kit
  vendor: holtek
  socs:
    - name: ht32f52341
```

## boards/holtek/esk32_30502/esk32_30502_defconfig
```kconfig
# SPDX-License-Identifier: Apache-2.0

# Board Configuration
CONFIG_SOC_SERIES_HT32F5XXXX=y
CONFIG_SOC_HT32F52341=y
CONFIG_BOARD_ESK32_30502=y

# Enable MPU
CONFIG_ARM_MPU=n

# Console
CONFIG_CONSOLE=y
CONFIG_UART_CONSOLE=y
CONFIG_SERIAL=y

# GPIO
CONFIG_GPIO=y

# Pinctrl
CONFIG_PINCTRL=y

# Clock Control
CONFIG_CLOCK_CONTROL=y

# XIP (Execute In Place)
CONFIG_XIP=y

# Main stack size
CONFIG_MAIN_STACK_SIZE=1024
```

## drivers/clock_control/holtek/Kconfig
```kconfig
# Copyright (c) 2025 Alex Fabre <alex.fabre@rtone.fr>
# SPDX-License-Identifier: Apache-2.0

config CLOCK_CONTROL_HT32
	bool "Holtek HT32 clock control driver"
	default y
	depends on DT_HAS_HOLTEK_HT32_CKCU_ENABLED
	help
	  Enable clock control driver for Holtek HT32 MCUs.
```

## drivers/cordic/Kconfig
```kconfig
# CORDIC configuration options

# Copyright (c) 2025 Alex Fabre
# SPDX-License-Identifier: Apache-2.0

#
# CORDIC options
#
menuconfig CORDIC
	bool "CORDIC drivers"

if CORDIC

config CORDIC_INIT_PRIORITY
	int "CORDIC devices init priority"
	default 90
	help
	  CORDIC devices initialization priority.

config CORDIC_SIN_COS
	bool "Enable sine and cosine operations"
	default n

config CORDIC_PHASE_MODULUS
	bool "Enable phase and modulus operations"
	default n

module = CORDIC
module-str = CORDIC
source "subsys/logging/Kconfig.template.log_config"

source "drivers/CORDIC/Kconfig.stm32"

endif # CORDIC
```

## drivers/cordic/Kconfig.stm32
```kconfig
# STM32 CORDIC Accelerator configuration options

# Copyright (c) 2025 Alex Fabre <alex.fabre@rtone.frm>
# SPDX-License-Identifier: Apache-2.0

menuconfig CORDIC_STM32
	bool "STM32 CORDIC Accelerator driver"
	default y
	depends on DT_HAS_ST_STM32_CORDIC_ENABLED
	help
	  Enable STM32 LL-based CORDIC Accelerator driver.
```

## drivers/gpio/holtek/Kconfig
```kconfig
# Copyright (c) 2025 Alex Fabre <alex.fabre@rtone.fr>
# SPDX-License-Identifier: Apache-2.0

config GPIO_HT32
	bool "Holtek HT32 GPIO driver"
	default y
	depends on DT_HAS_HOLTEK_HT32_GPIO_ENABLED
	help
	  Enable GPIO driver for Holtek HT32 MCUs.
```

## drivers/pinctrl/holtek/Kconfig
```kconfig
# Copyright (c) 2025 Alex Fabre <alex.fabre@rtone.fr>
# SPDX-License-Identifier: Apache-2.0

config PINCTRL_HT32
	bool "Holtek HT32 pinctrl driver"
	default y
	depends on SOC_FAMILY_HOLTEK_HT32
	help
	  Enable pinctrl driver for Holtek HT32 MCUs.
```

## drivers/sensor/daly_bms/Kconfig
```kconfig
# Daly BMS configuration options

# Copyright (c) 2025 Alex Fabre
# SPDX-License-Identifier: Apache-2.0

menuconfig DALY_BMS
	bool "Daly BMS"
	default y
	depends on DT_HAS_DALY_BMS_ENABLED
	help
	  Enable UART/CAN-based driver for a Daly BMS.

if DALY_BMS

config DALY_BMS_BUS_UART
	bool "Daly BMS UART driver"
	default y
	depends on $(dt_compat_on_bus,$(DT_COMPAT_DALY_BMS),uart)
	depends on UART_INTERRUPT_DRIVEN
	select UART

config DALY_BMS_BUS_CAN
	bool "Daly BMS CAN driver"
	default y
	depends on $(dt_compat_any_has_prop,$(DT_COMPAT_DALY_BMS),can-bus)
	select CAN

endif # DALY_BMS
```

## drivers/sensor/nooploop/tofsense/Kconfig
```kconfig
# Copyright (c) 2025 Alex Fabre
# SPDX-License-Identifier: Apache-2.0

config TOFSENSE
	bool "Nooploop TOFSense ToF sensor"
	default y
	depends on DT_HAS_NOOPLOOP_TOFSENSE_ENABLED
	depends on UART_INTERRUPT_DRIVEN
	help
	  Enable driver for the Nooploop TOFSense time of flight sensor.
```

## drivers/serial/holtek/Kconfig
```kconfig
# Copyright (c) 2025 Alex Fabre <alex.fabre@rtone.fr>
# SPDX-License-Identifier: Apache-2.0

config UART_HT32
	bool "Holtek HT32 UART/USART driver"
	default y
	depends on DT_HAS_HOLTEK_HT32_UART_ENABLED || DT_HAS_HOLTEK_HT32_USART_ENABLED
	select SERIAL_HAS_DRIVER
	select SERIAL_SUPPORT_INTERRUPT
	help
	  Enable UART/USART driver for Holtek HT32 MCUs.
```

## drivers/swd/Kconfig
```kconfig
# SWD configuration options

# Copyright (c) 2025 Alex Fabre
# SPDX-License-Identifier: Apache-2.0

#
# SWD options
#
menuconfig SWD
	bool "Serial Wire Debug (SWD) bus drivers"
	help
	  Enable SWD Driver Configuration

if SWD

config SWD_SHELL
	bool "SWD Shell"
	depends on SHELL
	help
	  Enable SWD Shell.

	  The SWD shell supports scanning, SWD read and write
	  operations.

endif # SWD
```

## drivers/watchdog/Kconfig.ti_tps3851
```kconfig
# Copyright (c) 2025 Alex Fabre
#
# SPDX-License-Identifier: Apache-2.0

config WDT_TI_TPS3851
	bool "External TI TPS3851 Watchdog (WDT) Driver"
	default y
	depends on DT_HAS_TI_TPS3851_ENABLED
	depends on GPIO
	help
	  Enable WDT driver for TI TPS3851. This is an external IC and requires
	  three GPIO connections from the processor.
```

## dts/bindings/gpio/holtek/holtek,ht32-gpio.yaml
```yaml
# Copyright (c) 2025 Alex Fabre <alex.fabre@rtone.fr>
# SPDX-License-Identifier: Apache-2.0

description: Holtek HT32 GPIO controller

compatible: "holtek,ht32-gpio"

include: [gpio-controller.yaml, base.yaml]

properties:
  reg:
    required: true

  "#gpio-cells":
    const: 2

gpio-cells:
  - pin
  - flags
```

## dts/bindings/pinctrl/holtek,ht32-pinctrl.yaml
```yaml
# Copyright (c) 2025 Alex Fabre <alex.fabre@rtone.fr>
# SPDX-License-Identifier: Apache-2.0

description: |
  Holtek HT32 pin controller

  The Holtek HT32 pin controller uses the AFIO (Alternate Function I/O)
  to configure pins for peripheral functions or as GPIO.

compatible: "holtek,ht32-afio"

include: base.yaml

properties:
  reg:
    required: true
```

## dts/bindings/sensor/nooploop,tofsense-common.yaml
```yaml
# Copyright (c) 2025 Alex Fabre
# SPDX-License-Identifier: Apache-2.0

description: |
    When setting the odr property in a .dts or .dtsi file you may include
    tofsense.h and use the macros defined there.

    Example:
    #include <zephyr/dt-bindings/sensor/tofsense.h>

    tofsense: tofsense@0 {
      ...
      reg = <0>;
      operating-mode = <TOFSENSE_MODE_ACTIVE>;
    };

include: "sensor-device.yaml"

properties:
  operating-mode:
    type: int
    default: 0
    required: true
    description: |
      Specify the sensor operating mode for CAN or UART.

      - ACTIVE mode: the module actively outputs measurement
      information at a frequency of 30Hz.
      
      - QUERY mode: the controller sends a query instruction
      containing the module ID to the expected query module,
      and the module can output one frame of measurement information
      
      Default is ACTIVE configuration.

      - 0 # TOFSENSE_MODE_ACTIVE
      - 1 # TOFSENSE_MODE_QUERY

    enum: [0, 1]
  
  active-mode-frequency:
    type: int
    default: 30
    required: false
    description: |
      Specify the sensor data output frequency.
      It's required only when 'operating-mode' is set to 'ACTIVE'.

      Default is 30Hz (The sensor will emmit new data message every ~33ms).
```

## dts/bindings/serial/holtek,ht32-uart.yaml
```yaml
# Copyright (c) 2025 Alex Fabre <alex.fabre@rtone.fr>
# SPDX-License-Identifier: Apache-2.0

description: Holtek HT32 UART

compatible: "holtek,ht32-uart"

include: [uart-controller.yaml, pinctrl-device.yaml]

properties:
  reg:
    required: true

  interrupts:
    required: true

  current-speed:
    type: int
    description: Initial baud rate setting for UART
```

## dts/bindings/watchdog/ti,tps3851.yaml
```yaml
# Copyright (c) 2025, Alex Fabre
# SPDX-License-Identifier: Apache-2.0

description: Watchdog driver for external IC (TPS3851)

compatible: "ti,tps3851"

include: base.yaml

properties:
  wdo-gpios:
    type: phandle-array
    description: |
      Optional GPIO used to catch watchdog output signal (timeout).
      Goes low (asserts) when a watchdog timeout occurs.
      This GPIO is optional because it may be routed to some hardware
      logic directly.
      When set, this GPIO calls the watchdog callback on falling-edge event.

  wdi-gpios:
    type: phandle-array
    required: true
    description: |
      Watchdog input (feed). A falling edge must occur at
      WDI before the timeout expires.
  
  set1-gpios:
    type: phandle-array
    description: |
      Optional GPIO used to enable (High) or disable (Low) the watchdog timer.
      This GPIO is optional because it may be routed to HIGH by hardware
      design directly.

  timeout-period:
    type: int
    required: true
    description: |
      The TPS3851 features three options for setting the watchdog timer. 
      1. Connecting a capacitor to the CWD pin: A formula 
         gives the timings according to the capacitor value.
      2. Connecting a pullup resistor to VDD.
      3. Leaving the CWD pin unconnected.

      PS: Beware that two version of the IC exist: TPS3851xxxS with standard 
      timings formula and TPS3851xxxE with extended timings formula. 
```

## samples/philosophers/sample.yaml
```yaml
sample:
  name: Dining Philosophers
common:
  extra_args: DEBUG_PRINTF=1
  tags:
    - introduction
    - kernel
  harness: console
  min_ram: 16
  integration_platforms:
    - native_sim
  harness_config:
    type: multi_line
    ordered: false
    regex:
      - ".*STARVING.*"
      - ".*DROPPED ONE FORK.*"
      - ".*THINKING.*"
      - ".*EATING.*"
tests:
  sample.philosopher: {}
  sample.philosopher.same_prio:
    extra_args: SAME_PRIO=1
  sample.philosopher.static:
    extra_args: STATIC_OBJS=1
  sample.philosopher.semaphores:
    extra_args: FORKS=SEMAPHORES
  sample.philosopher.stacks:
    extra_args: FORKS=STACKS
  sample.philosopher.fifos:
    extra_args: FORKS=FIFOS
  sample.philosopher.lifos:
    extra_args: FORKS=LIFOS
  sample.philosopher.preempt_only:
    extra_configs:
      - CONFIG_NUM_PREEMPT_PRIORITIES=6
      - CONFIG_NUM_COOP_PRIORITIES=0
      - CONFIG_BT=n
      - CONFIG_NETWORKING=n
  sample.philosopher.coop_only:
    extra_configs:
      - CONFIG_NUM_PREEMPT_PRIORITIES=0
      - CONFIG_NUM_COOP_PRIORITIES=7
```

## soc/holtek/ht32/Kconfig
```kconfig
# Copyright (c) 2025 Alex Fabre <alex.fabre@rtone.fr>
# SPDX-License-Identifier: Apache-2.0

config SOC_FAMILY_HOLTEK_HT32
	bool

if SOC_FAMILY_HOLTEK_HT32

config SOC_FAMILY
	string
	default "holtek_ht32"

source "soc/holtek/ht32/*/Kconfig.soc"

endif # SOC_FAMILY_HOLTEK_HT32
```

## soc/holtek/ht32/Kconfig.defconfig
```kconfig
# Copyright (c) 2025 Alex Fabre <alex.fabre@rtone.fr>
# SPDX-License-Identifier: Apache-2.0

if SOC_FAMILY_HOLTEK_HT32

source "soc/holtek/ht32/*/Kconfig.defconfig"

endif # SOC_FAMILY_HOLTEK_HT32
```

## soc/holtek/ht32/f5/Kconfig
```kconfig
# Copyright (c) 2025 Alex Fabre <alex.fabre@rtone.fr>
# SPDX-License-Identifier: Apache-2.0

config SOC_SERIES_HT32F5XXXX
	bool
	help
	  Enable support for Holtek HT32F5xxxx MCU series
```

## soc/holtek/ht32/f5/Kconfig.defconfig
```kconfig
# Copyright (c) 2025 Alex Fabre <alex.fabre@rtone.fr>
# SPDX-License-Identifier: Apache-2.0

if SOC_SERIES_HT32F5XXXX

config NUM_IRQS
	default 32

config SYS_CLOCK_HW_CYCLES_PER_SEC
	default 48000000

endif # SOC_SERIES_HT32F5XXXX
```

## soc/holtek/ht32/f5/Kconfig.soc
```kconfig
# Copyright (c) 2025 Alex Fabre <alex.fabre@rtone.fr>
# SPDX-License-Identifier: Apache-2.0

config SOC_SERIES_HT32F5XXXX
	bool
	select SOC_FAMILY_HOLTEK_HT32
	select ARM
	select CPU_CORTEX_M0PLUS
	select CPU_CORTEX_M_HAS_SYSTICK
	help
	  Enable support for HT32F5xxxx series

config SOC_SERIES
	default "ht32f5xxxx" if SOC_SERIES_HT32F5XXXX

config SOC_HT32F52331
	bool
	select SOC_SERIES_HT32F5XXXX

config SOC_HT32F52341
	bool
	select SOC_SERIES_HT32F5XXXX

config SOC_HT32F52342
	bool
	select SOC_SERIES_HT32F5XXXX

config SOC_HT32F52352
	bool
	select SOC_SERIES_HT32F5XXXX

config SOC
	default "ht32f52331" if SOC_HT32F52331
	default "ht32f52341" if SOC_HT32F52341
	default "ht32f52342" if SOC_HT32F52342
	default "ht32f52352" if SOC_HT32F52352
```
