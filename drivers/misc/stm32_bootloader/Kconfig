## drivers/misc/stm32_bootloader/Kconfig
```kconfig
# STM32 System Bootloader Driver

# Copyright (c) 2026 Alex Fabre
# SPDX-License-Identifier: Apache-2.0

config STM32_BOOTLOADER
    bool "STM32 system bootloader driver"
    default y
    depends on \
      DT_HAS_ST_STM32_BOOTLOADER_UART_ENABLED || \
      DT_HAS_ST_STM32_BOOTLOADER_CAN_ENABLED || \
      DT_HAS_ST_STM32_BOOTLOADER_USB_ENABLED || \
      DT_HAS_ST_STM32_BOOTLOADER_I2C_ENABLED || \
      DT_HAS_ST_STM32_BOOTLOADER_I3C_ENABLED || \
      DT_HAS_ST_STM32_BOOTLOADER_SPI_ENABLED || \
      DT_HAS_ST_STM32_BOOTLOADER_FDCAN_ENABLED
    depends on GPIO
    help
      STM32 devices have an internal bootloader stored in their internal boot
      ROM. This driver aims to let users interact with the system bootloader
      of a target stm32 device following AN2606 protocol.
      
      STM32 system bootloader communication is available through various serial
      peripherals (such as USART, CAN, USB, I2C, I3C, SPI, FDCAN) depending on
      the STM32 reference.

if STM32_BOOTLOADER

config STM32_BOOTLOADER_WRITE_CHUNK_SIZE
	int "Write chunk size"
	default 256
	range 1 256
	help
	  Maximum number of bytes to send per Write Memory command.

module = STM32_BOOTLOADER
module-str = stm32_bootloader
source "subsys/logging/Kconfig.template.log_config"

endif # STM32_BOOTLOADER

rsource "usart/Kconfig"
```

## drivers/misc/stm32_bootloader/usart/Kconfig
```kconfig
# STM32 UART System Bootloader Driver

# Copyright (c) 2025 Contributors to the Zephyr Project
# SPDX-License-Identifier: Apache-2.0

config STM32_BOOTLOADER_UART
	bool "STM32 UART system bootloader driver"
	default y
	depends on STM32_BOOTLOADER
	depends on DT_HAS_ST_STM32_BOOTLOADER_UART_ENABLED
	depends on SERIAL
	help
	  Enable driver for programming a target STM32 MCU via its built-in
	  USART system bootloader (AN3155 protocol). The host controls NRST,
	  BOOT0 and optionally BOOT1 via GPIO, and communicates over UART.

if STM32_BOOTLOADER_UART

config STM32_BOOTLOADER_UART_INIT_PRIORITY
	int "Init priority"
	default 90
	help
	  Device driver initialization priority. Must be after GPIO and UART.

module = STM32_BOOTLOADER_UART
module-str = stm32_bootloader_uart
source "subsys/logging/Kconfig.template.log_config"

endif # STM32_BOOTLOADER_UART
```

## dts/bindings/misc/st,stm32-bootloader-uart.yaml
```yaml
# SPDX-License-Identifier: Apache-2.0
# Copyright (c) 2025 Contributors to the Zephyr Project

description: |
  STM32 UART System Bootloader interface.

  Allows a host MCU to program a target STM32 via its built-in USART system
  bootloader (ST AN3155 protocol). The host controls the target's BOOT0
  (and BOOT1 for some refs) pin and NRST via GPIO, can optionally read the
  firmware to push from a given flash partition, and pushes it over UART.

compatible: "st,stm32-bootloader-uart"

include: [uart-device.yaml, "st,stm32-bootloader.yaml"]

properties:
  timeout-ms:
    type: int
    default: 100
    description: Command response timeout in milliseconds.
  
  baudrate:
    type: int
    default: 115200
    description: |
      The STM32 bootloader auto-detects the host baudrate between a minimum
      of 1200 up to a maximum of 115200.

  parity-none:
    type: boolean
    description: |
      Set this flag is the target STM32 requires UART with no parity.

      On STM32 the UART bootloader peripheral is configured with even parity.
      The STM32WB0 series and STM32WL3x line, are the only exception having their
      UART bootloader peripheral configured with no parity.
```

## dts/bindings/misc/st,stm32-bootloader.yaml
```yaml
# SPDX-License-Identifier: Apache-2.0
# Copyright (c) 2025 Contributors to the Zephyr Project

description: |
  Common properties for STM32 system bootloader interfaces.

  Shared by all transport-specific bindings (USART, I2C, CAN, etc.).
  The host controls the target's BOOT0 (and optionally BOOT1) pin and
  NRST via GPIO.

properties:
  boot0-gpios:
    type: phandle-array
    required: true
    description: |
      GPIO connected to the target STM32 BOOT0 (or BOOT) pin.
      Refer to AN2606 to check the BOOT0 pin logical level 
      and option bytes value requirements for your specific STM32.

  boot1-gpios:
    type: phandle-array
    description: |
      GPIO connected to the target STM32 BOOT1 pin.
      Not all STM32 have a BOOT1 pin.
      Refer to AN2606 to check the BOOT1 pin logical level
      and option bytes value requirements for your specific STM32.

  nrst-gpios:
    type: phandle-array
    required: true
    description: GPIO connected to the target STM32 NRST (reset) pin.

  reset-pulse-ms:
    type: int
    default: 1
    description: NRST pulse duration in milliseconds.

  boot-delay-ms:
    type: int
    default: 10
    description: |
      After device reset, the host must wait until the STM32 bootloader is
      ready to start detection phase with a specific interface communication.
      This time corresponds to bootloader startup timing, during which
      resources used by bootloader are initialized.

      Depending on the bootloader model, the startup timing calculation
      differs from one product to another. Refer to AN2606 for more details.
  
  erase-timeout-ms:
    type: int
    default: 35000
    description: |
      Timeout in milliseconds for mass erase operations.
      Mass erase on some STM32 devices can take 30+ seconds.
```
